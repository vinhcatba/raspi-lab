## TH2.1/Kconfig
```kconfig
menu "hello kernel module"

config HELLO
    tristate "hello kernel"
    depends on ARM
    default y if ARM
    help
        Select this to run hello kernel module
endmenu
```
